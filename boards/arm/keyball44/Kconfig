## boards/arm/keyball44/Kconfig
```kconfig
config BOARD_ENABLE_DCDC
  bool "Enable DCDC mode"
  select SOC_DCDC_NRF52X
  default y
  depends on (BOARD_KEYBALL44_LEFT || BOARD_KEYBALL44_RIGHT)

config BOARD_ENABLE_DCDC_HV
  bool "High voltage DCDC converter"
  default y
  depends on (BOARD_KEYBALL44_LEFT || BOARD_KEYBALL44_RIGHT)
```

## boards/arm/keyball44/Kconfig.board
```kconfig
# SPDX-License-Identifier: MIT

config BOARD_KEYBALL44_LEFT
  bool "Keyball44 Left"
  depends on SOC_NRF52840_QIAA

config BOARD_KEYBALL44_RIGHT
  bool "Keyball44 Right"
  depends on SOC_NRF52840_QIAA
```

## boards/arm/keyball44/Kconfig.defconfig
```kconfig
if BOARD_KEYBALL44_LEFT

config ZMK_KEYBOARD_NAME
  default "Keyball44"

config BOARD
  default "keyball44 left"

config ZMK_SPLIT_ROLE_CENTRAL
  default y

endif # BOARD_KEYBALL44_LEFT

if BOARD_KEYBALL44_RIGHT

config BOARD
  default "keyball44 right"

endif # BOARD_KEYBALL44_RIGHT

if BOARD_KEYBALL44_LEFT || BOARD_KEYBALL44_RIGHT

config ZMK_SPLIT
  default y

config BT_CTLR
  default BT

config PINCTRL
  default y

config ZMK_KSCAN_MATRIX_WAIT_BETWEEN_OUTPUTS
    default 5

if USB

config USB_NRFX
  default y

config USB_DEVICE_STACK
  default y

endif # USB

config SPI
  default y

endif # BOARD_KEYBALL44_LEFT ||  BOARD_KEYBALL44_RIGHT

if ZMK_DISPLAY

config I2C
    default y

config SSD1306
    default y

choice ZMK_DISPLAY_WORK_QUEUE
    default ZMK_DISPLAY_WORK_QUEUE_DEDICATED
endchoice

endif

if LVGL

config LV_Z_VDB_SIZE
    default 64

config LV_DPI_DEF
    default 148

config LV_Z_BITS_PER_PIXEL
    default 1

choice LV_COLOR_DEPTH
    default LV_COLOR_DEPTH_1
endchoice

endif 
```

## config/boards/shields/keyball44/Kconfig
```kconfig
config BOARD_ENABLE_DCDC
  bool "Enable DCDC mode"
  select SOC_DCDC_NRF52X
  default y
  depends on (SHIELD_KEYBALL44_LEFT || SHIELD_KEYBALL44_RIGHT)

config BOARD_ENABLE_DCDC_HV
  bool "High voltage DCDC converter"
  default y
  depends on (SHIELD_KEYBALL44_LEFT || SHIELD_KEYBALL44_RIGHT)
```

## config/boards/shields/keyball_nano/Kconfig.board
```kconfig
# SPDX-License-Identifier: MIT

config SHIELD_KEYBALL44_LEFT
  bool "Levels54 Left"
  depends on SOC_NRF52840_QIAA

config SHIELD_KEYBALL44_RIGHT
  bool "Levels54 Right"
  depends on SOC_NRF52840_QIAA
```

## config/west.yml
```yaml
manifest:
  remotes:
    - name: YkieWang
      url-base: https://github.com/YkieWang
    - name: inorichi
      url-base: https://github.com/inorichi
  projects:
    - name: zmk
      remote: YkieWang
      revision: e844eca2e9e3f56443b1e27d18c23144ca35b6ad
      import: app/west.yml
    - name: zmk-pmw3610-driver
      remote: inorichi
      revision: 1d9c2c68ca76012e1b1e5f6ef02fa5eadc4ca399
  self:
    path: config
```
